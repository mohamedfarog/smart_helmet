## application/boards/nordic/nrf7002dk_nrf5340_cpuapp/Kconfig.defconfig
```kconfig
if BOARD_NRF7002DK_NRF5340_CPUAPP

config BT_CTLR
	default BT

endif # BOARD_NRF7002DK_NRF5340_CPUAPP
```

## application/boards/nordic/nrf7002dk_nrf5340_cpuapp/board.yml
```yaml
board:
  name: nrf7002dk_nrf5340_cpuapp
  vendor: nordic
  socs:
    - name: nrf52832
```

## application/boards/nordic/shiarsband/Kconfig.shiarsband
```kconfig
config BOARD_SHIARSBAND
	select SOC_NRF5340_CPUAPP_QKAA if BOARD_SHIARSBAND_NRF5340_CPUAPP
	select SOC_NRF5340_CPUAPP_QKAA if BOARD_SHIARSBAND_NRF5340_CPUAPP_NS
	select SOC_NRF5340_CPUNET_QKAA if BOARD_SHIARSBAND_NRF5340_CPUNET
```

## application/boards/nordic/shiarsband/board.yml
```yaml
board:
  name: shiarsband
  vendor: nordic
  socs:
  - name: nrf5340
    variants:
    - name: ns
      cpucluster: cpuapp
```

## application/boards/nordic/shiarsband/shiarsband_nrf5340_cpuapp_defconfig
```kconfig
CONFIG_ARM_MPU=y
CONFIG_HW_STACK_PROTECTION=y

CONFIG_ARM_TRUSTZONE_M=y

# enable GPIO
CONFIG_GPIO=y

# Enable uart driver
CONFIG_SERIAL=y

# enable console
CONFIG_CONSOLE=y
CONFIG_UART_CONSOLE=y

CONFIG_PINCTRL=y

CONFIG_CLOCK_CONTROL_NRF_K32SRC_RC=y
# Ensure GPIO P0.01 and P0.00 can be used
CONFIG_SOC_ENABLE_LFXO=n
```

## application/drivers/Kconfig
```kconfig
# rsource "display/Kconfig"
# rsource "kscan/Kconfig"
menu "Drivers"
    rsource "sensor/Kconfig" 
endmenu
```

## application/src/sensors/Kconfig
```kconfig
module = AW_SENSORS
module-str = AW_SENSORS
source "subsys/logging/Kconfig.template.log_config"
```
