/dts-v1/;
#include <nordic/nrf5340_cpuappns_qkaa.dtsi>
#include "shiarsband_common.dtsi"

/ {
	model = "Custom Board auto generated by nRF Connect for VS Code (CPUAPP Non-Secure)";
	compatible = "nordic,shiarsband-cpuapp-ns";

	chosen {
		zephyr,sram = &sram0_ns;
		zephyr,flash = &flash0;
		zephyr,code-partition = &slot0_ns_partition;
	};
};

#include "shiarsband-cpuapp_partitioning.dtsi"
#include "shiarsband-shared_sram.dtsi"
