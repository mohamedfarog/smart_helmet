/dts-v1/;
#include <nordic/nrf5340_cpuapp_qkaa.dtsi>
#include "shiarsband_common.dtsi"

/ {
	model = "Custom Board auto generated by nRF Connect for VS Code (CPUAPP)";
	compatible = "nordic,shiarsband-cpuapp";

	chosen {
		zephyr,sram = &sram0_image;
		zephyr,flash = &flash0;
		zephyr,code-partition = &slot0_partition;
		zephyr,sram-secure-partition = &sram0_s;
		zephyr,sram-non-secure-partition = &sram0_ns;
	};
	
	aliases {
		watchdog0 = &wdt0;
	};
};

#include "shiarsband-cpuapp_partitioning.dtsi"
#include "shiarsband-shared_sram.dtsi"

